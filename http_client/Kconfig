## http_client/Kconfig
```kconfig
# Private config options for http-client sample app

# Copyright (c) 2020 Intel Corporation
# SPDX-License-Identifier: Apache-2.0

mainmenu "Networking http-client sample application"

config NET_SAMPLE_SEND_ITERATIONS
	int "Send a sample HTTP query this many times"
	default 0
	help
	  Send a sample HTTP query this many times before exiting. A value of
	  zero means that the sample application in default way.

mainmenu "ESP32-S2 Wi-Fi options"

if WIFI_ESP32

config ESP32_WIFI_SSID
	default "MY_SSID"

config ESP32_WIFI_PASSWORD
	default "MY_PASSWORD"

endif # WIFI_ESP32

if DNS_RESOLVER

config DNS_SERVER_IP_ADDRESSES
	default y

config DNS_SERVER1
	default "1.1.1.1"

endif # DNS_RESOLVER

source "Kconfig.zephyr"
```

## wifi/Kconfig
```kconfig
# Copyright (c) 2021 Golioth, Inc.
# SPDX-License-Identifier: Apache-2.0

mainmenu "ESP32-S2 Wi-Fi options"

if WIFI_ESP32

config ESP32_WIFI_SSID
	default "MY_SSID"

config ESP32_WIFI_PASSWORD
	default "MY_PASSWORD"

endif # WIFI_ESP32

if DNS_RESOLVER

config DNS_SERVER_IP_ADDRESSES
	default y

config DNS_SERVER1
	default "1.1.1.1"

endif # DNS_RESOLVER

source "Kconfig.zephyr"
```
