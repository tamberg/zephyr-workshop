/ {
    aliases {
        led0 = &led0;
    };

    leds {
        compatible = "gpio-leds";
        led0: led {
            gpios = <&gpio0 18 GPIO_ACTIVE_HIGH>;
            label = "Red LED";
        };
    };
};
